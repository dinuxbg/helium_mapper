## west.yml
```yaml
# Copyright (c) 2021 Nordic Semiconductor ASA
# SPDX-License-Identifier: Apache-2.0

manifest:
  defaults:
    remote: upstream

  self:
    path: helium_mapper

  remotes:
    - name: upstream
      url-base: https://github.com/zephyrproject-rtos
    - name: retfie
      url-base: https://github.com/retfie

  projects:
    - name: zephyr
      remote: upstream
      revision: 5fc96ff9d70f7828b5eada42de04c521cd0904e1
      import:
        name-allowlist:
          - cmsis
          - hal_nordic
          - segger
          - tinycrypt
          - loramac-node
          - mbedtls
    - name: mcuboot
      revision: b994ba2ce29425587957dcbb6c96d4e1872b5737
      path: bootloader/mcuboot
    - name: zcbor
      revision: 0.6.0
      path: modules/lib/zcbor
```
